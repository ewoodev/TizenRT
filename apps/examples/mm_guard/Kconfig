## apps/examples/mm_guard/Kconfig
```kconfig
#
# For a description of the syntax of this configuration file,
# see kconfig-language at https://www.kernel.org/doc/Documentation/kbuild/kconfig-language.txt
#

config EXAMPLES_MM_GUARD
	bool "Heap Use After Free Guard Test Example"
	default n
	depends on MM_GUARD_FREED_PAGES
	select DRIVERS_OS_API_TEST
	---help---
		Enable the front end for the heap use-after-free guard test.  The test
		itself runs in kernel space, because the memory it abuses is the kernel
		heap, and is reached through the OS API test driver.

config USER_ENTRYPOINT
	string
	default "mm_guard_main" if ENTRY_MM_GUARD
```

## os/mm/Kconfig
```kconfig
#
# For a description of the syntax of this configuration file,
# see kconfig-language at https://www.kernel.org/doc/Documentation/kbuild/kconfig-language.txt
#

config MM_KERNEL_HEAP
	bool
	default y

config REALLOC_DISABLE_NEIGHBOR_EXTENSION
	bool "Disable Realloc Neighbor Extension"
	default n
	---help---
		If enabled, realloc will not expand from old node to neighbor freenode.
		Instead, realloc will do "malloc new node, memcpy, free old node" which is safe,
		but waste of time and memory space. And it will be one of debugging
		features, especially when you modify existing malloc/free logic.

config KMM_REGIONS
	int "Number of kernel memory regions"
	default 1
	---help---
		If the architecture includes multiple, non-contiguous regions of
		memory to allocate from, KMM_REGIONS should be set to the number of
		memory. Or if you want to use multiple kernel heap, KMM_REGIONS
		should be set to the number of heaps.

config KMM_NHEAPS
	int "Number of kernel heaps"
	default 1
	---help---
		A number of kernel heap memory. If KMM_NHEAPS sets more than equal to 2,
		it can be split for multi kernel heap.
		You can refer to "https://github.com/Samsung/TizenRT/blob/master/docs/HowToUseMultiHeap.md"

config KMM_FORCE_ALLOC_AT
	bool "Force to alloc at specific mm heap for kernel"
	default n
	depends on KMM_NHEAPS != 1
	depends on MM_KERNEL_HEAP
	---help---
		When Enable multi heap, it's possible that need to alloc memory from
		specific heap for kernel

config KMM_FORCE_ALLOC_IDX
	int "Heap index for kernel memory"
	default 0
	depends on KMM_FORCE_ALLOC_AT
	---help---
		Index of the heap that need to alloc for kernel forcedly

config GRAN
	bool "Enable Granule Allocator"
	default n
	---help---
		Enable granule allocator support.  Allocations will be aligned to the
		granule size; allocations will be in units of the granule size.
		Larger granules will give better performance and less overhead but
		more losses of memory due to alignment and quantization waste.

		NOTE: The current implementation also restricts the maximum
		allocation size to 32 granaules.  That restriction could be
		eliminated with some additional coding effort.

config GRAN_SINGLE
	bool "Single Granule Allocator"
	default n
	depends on GRAN
	---help---
		Select if there is only one instance of the granule allocator (i.e.,
		gran_initialize will be called only once. In this case, (1) there
		are a few optimizations that can can be done and (2) the GRAN_HANDLE
		is not needed.

config GRAN_INTR
	bool "Interrupt level support"
	default n
	depends on GRAN
	---help---
		Normally mutual exclusive access to granule allocator data is assured
		using a semaphore.  If this option is set then, instead, mutual
		exclusion logic will disable interrupts.  While this options is more
		invasive to system performance, it will also support use of the granule
		allocator from interrupt level logic.

config DEBUG_GRAN
	bool "Granule Allocator Debug"
	default n
	depends on GRAN && DEBUG
	---help---
		Just like DEBUG_MM, but only generates output from the gran
		allocation logic.

config MM_PGALLOC
	bool "Enable Page Allocator"
	default n
	depends on ARCH_USE_MMU
	select GRAN
	---help---
		Enable support for a MMU physical page allocator based on the
		granule allocator.

if MM_PGALLOC

config MM_PGSIZE
	int "Page Size"
	default 4096
	---help---
		The MMU page size.  Must be one of {1024, 2048, 4096, 8192, or
		16384}.  This is easily extensible, but only those values are
		currently support.

config DEBUG_PGALLOC
	bool "Page Allocator Debug"
	default n
	depends on DEBUG
	---help---
		Just like DEBUG_MM, but only generates output from the page
		allocation logic.

endif # MM_PGALLOC

config MM_ASSERT_ON_FAIL
	bool "Assertion when Memory allocation fail"
	default y
	select MMINFO if APP_BINARY_SEPARATION
	---help---
		When memory allocation fails, make assertion.
		From the application binary with loadable build, it will be reloaded.

config MM_DUMP_CORRPUTED_HEAP
	bool "Dump the complete corrupted heap"
	default n
	---help---
		When we find a heap corruption, we can dump the entire heap, so that
		it can be manually analyzed to find more information about the corruption.

config MM_ALLOC_LARGE_FROM_BACK
	bool "Allocate large chunks from the back of free chunks"
	default n
	---help---
		Reduce heap fragmentation by separating small and large
		allocations. When enabled, chunks whose total size (requested
		size + allocation header, aligned to the memory granule) is
		greater than or equal to MM_LARGE_ALLOC_THRESHOLD are carved
		from the high-address end of the selected free chunk, while
		smaller chunks continue to be carved from the low-address end.

config MM_LARGE_ALLOC_THRESHOLD
	int "Large allocation threshold (bytes)"
	default 1048576
	depends on MM_ALLOC_LARGE_FROM_BACK
	---help---
		Allocations whose physical chunk size (user requested size +
		SIZEOF_MM_ALLOCNODE, granule aligned) is greater than or equal
		to this value are placed at the back of the selected free
		chunk. Default is 512KB. Must be larger than SIZEOF_MM_FREENODE.

config MM_GUARD_FREED_PAGES
	bool "Detect use after free with the MMU"
	default n
	depends on MMU_GUARD && MM_KERNEL_HEAP && DEBUG_MM_FREEINFO
	---help---
		Make the pages that lie entirely inside a freed kernel heap chunk
		inaccessible, so that a read or write through a dangling pointer takes a
		data abort at the offending instruction instead of silently corrupting
		whoever gets the memory next. The report names the address, the faulting
		instruction, and the task and call site that allocated and freed the chunk.

		Only whole 4KB pages can be protected, and the first bytes of a payload
		hold the free list links, so a payload has to be about 8KB before it is
		guaranteed to contain a full page. Smaller allocations are not covered.

		This is a debug facility. It cleans the data cache and rewrites page table
		entries on every free of a large chunk.

if MM_GUARD_FREED_PAGES

config MM_GUARD_NSECTIONS
	int "Sections of the heap to cover"
	default 56
	range 1 512
	---help---
		How many 1MB sections of the kernel heap can be protected, which is also
		1KB of translation table each in .bss.

		The guard covers whole sections only and skips the first and the last
		section the heap touches, so the default should be at least
		(heap size / 1MB) - 1. What does not fit is reported at boot and left
		unguarded rather than silently skipped.

config MM_GUARD_CHUNK_MAX_PAGES
	int "Maximum pages protected per freed chunk"
	default 8
	range 0 512
	---help---
		Upper bound on the pages taken away for one freed chunk, which bounds the
		work done on the free and allocation paths. Zero means no bound, but then
		freeing the multi megabyte chunk at the top of the heap rewrites thousands
		of page table entries at once.

		A dangling pointer is almost always dereferenced near the start of the
		buffer, so a small bound loses very little detection.

config MM_GUARD_NRECORDS
	int "Freed chunks kept on record"
	default 32
	range 1 256
	---help---
		How many recently freed chunks keep their owner information, so that a
		violation can name who allocated and who freed the memory. A chunk that
		was freed longer ago than this is still detected, only its history is
		gone.

endif # MM_GUARD_FREED_PAGES
```
